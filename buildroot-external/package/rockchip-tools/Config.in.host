## buildroot-external/package/rockchip-tools/Config.in.host
```kconfig
config BR2_PACKAGE_ROCKCHIP_TOOLS
	bool "Rockchip devel tools"
	help
	  Rockchip devel tools (required by generating firmeare)
```
